## configs/rv32_defconfig
```kconfig
CONFIG_32BIT=y
CONFIG_CPU_RISCV_32=y
CONFIG_RISCV=y
CONFIG_SYS_TEXT_BASE=0x40000000
CONFIG_DEFAULT_DEVICE_TREE="rv32"
CONFIG_TARGET_HIFIVE_U540=y
CONFIG_FIT=y
CONFIG_OF_CONTROL=y
CONFIG_SYS_PROMPT="RV32 # "
CONFIG_BOOTDELAY=3
CONFIG_DM=y
#CONFIG_OF_BOARD=y
CONFIG_CMD_NET=y
CONFIG_CMD_DHCP=y
#CONFIG_DM_ETH=y
#CONFIG_MACB=y
CONFIG_LITEUART_SERIAL=y
CONFIG_LITEUART_SERIAL_ID=1
CONFIG_BAUDRATE=115200
CONFIG_ENV_IS_NOWHERE=y
CONFIG_PHYLIB=y
CONFIG_PHY_MSCC=y
CONFIG_SYS_NO_FLASH=y
CONFIG_IP_DYN=yes
CONFIG_NR_DRAM_BANKS=1
#CONFIG_EFI=y
CONFIG_HIFIVE_SPI=y
#CONFIG_MMC=y
#CONFIG_CMD_MMC=y
#CONFIG_CMD_MMC_SPI=y
#CONFIG_MMC_SPI=y
```
